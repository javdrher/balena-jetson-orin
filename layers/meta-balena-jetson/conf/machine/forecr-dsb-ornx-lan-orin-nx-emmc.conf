## layers/meta-balena-jetson/conf/machine/forecr-dsb-ornx-lan-orin-nx-emmc.conf
```bitbake
#@TYPE: Machine
#@NAME: Forecr DSBOARD ORNX LAN eMMC
##@DESCRIPTION: Forecr DSBOARD-ORNX-LAN Carrier Board for Nvidia Jetson Orin NX eMMC
#

MACHINEOVERRIDES = "p3509-a02-p3767-0000:jetson-orin-nx-xavier-nx-devkit:${MACHINE}"
include conf/machine/p3509-a02-p3767-0000.conf

# work-around for https://github.com/OE4T/meta-tegra/issues/400
MACHINEOVERRIDES := "${@'${MACHINEOVERRIDES}'.replace(':${MACHINE}',':p3509-a02-p3767-0000:jetson-orin-nx-xavier-nx-devkit:${MACHINE}')}"

# Uncomment this only if the dtb needs to be rebuilt.
KERNEL_DEVICETREE = "tegra234-p3767-0000-p3509-a02.dtb \
    tegra234-p3767-0000-p3768-0000-a0-dsboard-ornxlan-base-imx477.dtb \
    tegra234-p3767-0000-p3768-0000-a0-dsboard-ornxlan.dtb \
    tegra234-p3767-0000-p3768-0000-a0-dsboard-ornxlan-base.dtb \
    tegra234-p3767-0000-p3768-0000-a0-dsboard-ornxlan-imx477.dtb \
"
```

## layers/meta-balena-jetson/conf/machine/jetson-orin-nx-xavier-nx-devkit.conf
```bitbake
#@TYPE: Machine
#@NAME: Jetson Orin NX in Xavier NX Devkit
##@DESCRIPTION: Jetson Orin NX in Xavier NX Devkit carrier board
#

MACHINEOVERRIDES = "p3509-a02-p3767-0000:${MACHINE}"
include conf/machine/p3509-a02-p3767-0000.conf

# work-around for https://github.com/OE4T/meta-tegra/issues/400
MACHINEOVERRIDES := "${@'${MACHINEOVERRIDES}'.replace(':${MACHINE}',':p3509-a02-p3767-0000:${MACHINE}')}"

# Uncomment this only if the dtb needs to be rebuilt.
KERNEL_DEVICETREE = "tegra234-p3767-0000-p3509-a02.dtb \
    tegra234-p3767-0000-p3768-0000-a0-dsboard-ornxlan-base-imx477.dtb \
    tegra234-p3767-0000-p3768-0000-a0-dsboard-ornxlan.dtb \
    tegra234-p3767-0000-p3768-0000-a0-dsboard-ornxlan-base.dtb \
    tegra234-p3767-0000-p3768-0000-a0-dsboard-ornxlan-imx477.dtb \
"
```
